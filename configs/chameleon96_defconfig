## configs/chameleon96_defconfig
```kconfig
BR2_arm=y
BR2_cortex_a9=y
BR2_TOOLCHAIN_EXTERNAL=y
BR2_TARGET_GENERIC_HOSTNAME="chameleon96"
BR2_TARGET_GENERIC_ISSUE="Welcome to Buildroot on the Chameleon96"
BR2_ROOTFS_POST_IMAGE_SCRIPT="support/scripts/genimage.sh"
BR2_ROOTFS_POST_SCRIPT_ARGS="-c board/novtech/chameleon96/genimage.cfg"
BR2_LINUX_KERNEL=y
BR2_LINUX_KERNEL_CUSTOM_GIT=y
BR2_LINUX_KERNEL_CUSTOM_REPO_URL="https://github.com/Chameleon960/BSP-Linux"
BR2_LINUX_KERNEL_CUSTOM_REPO_VERSION="11ab2b393f57cb2741f7ec2ffcac33b20f21cc05"
BR2_LINUX_KERNEL_DEFCONFIG="chameleon96"
BR2_LINUX_KERNEL_DTS_SUPPORT=y
BR2_LINUX_KERNEL_INTREE_DTS_NAME="socfpga_chameleon96"
BR2_TARGET_ROOTFS_EXT2=y
BR2_TARGET_ROOTFS_EXT2_4=y
BR2_TARGET_ROOTFS_EXT2_SIZE="128M"
BR2_TARGET_ROOTFS_TAR_GZIP=y
BR2_TARGET_UBOOT=y
BR2_TARGET_UBOOT_BOARDNAME="socfpga_chameleon96"
BR2_TARGET_UBOOT_CUSTOM_GIT=y
BR2_TARGET_UBOOT_CUSTOM_REPO_URL="https://github.com/Chameleon960/BSP-U-boot"
BR2_TARGET_UBOOT_CUSTOM_REPO_VERSION="3c7bd7470b403ba3b514242161301f54e4e8fc33"
# BR2_TARGET_UBOOT_FORMAT_BIN is not set
BR2_TARGET_UBOOT_FORMAT_IMG=y
BR2_TARGET_UBOOT_SPL=y
BR2_TARGET_UBOOT_ALTERA_SOCFPGA_IMAGE_CRC=y
BR2_TARGET_UBOOT_BOOT_SCRIPT=y
BR2_TARGET_UBOOT_BOOT_SCRIPT_SOURCE="board/novtech/chameleon96/boot-env.txt"
BR2_PACKAGE_HOST_DOSFSTOOLS=y
BR2_PACKAGE_HOST_GENIMAGE=y
BR2_PACKAGE_HOST_GENPART=y
BR2_PACKAGE_HOST_MTOOLS=y
```
